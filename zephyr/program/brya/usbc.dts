/* Copyright 2022 The ChromiumOS Authors
 * Use of this source code is governed by a BSD-style license that can be
 * found in the LICENSE file.
 */

#include <dt-bindings/usb-c/pd.h>

/ {
	usbc {
		#address-cells = <1>;
		#size-cells = <0>;

		usbc_port1: port1@1 {
			compatible = "usb-c-connector";
			reg = <1>;
			tcpc = <&tcpc_port1>;
			vbus = <&tcpc_port1_vbus>;
			// ppc = <&ppc_port1>;
			power-role = "sink";
			sink-pdos = <PDO_FIXED(5000, 100, 0)>;
			source-pdos = <PDO_FIXED(5000, 500, 0)>;
		};
	};
};
